## meta-bah/conf/distro/bah.conf
```bitbake
require conf/distro/poky.conf

INIT_MANAGER = "systemd"
DISTRO_FEATURES:append = " usrmerge systemd wifi grep cpufrequtils wpa-supplicant"
DISTRO_FEATURES:remove = " sysvinit"
VIRTUAL-RUNTIME_syslog = ""
VIRTUAL-RUNTIME_base-utils-syslog = ""
DISTRO_FEATURES:remove = "wayland"
DISTRO_FEATURES:append = "systemd"
DISTRO_FEATURES:append = "ssh-server-openssh"
LICENSE_FLAGS_ACCEPTED = "synaptics-killswitch"
ENABLE_I2C = "1"
KERNEL_MODULE_AUTOLOAD:rpi += "i2c-dev i2c-bcm2708"
DISTRO_FEATURES:append = " systemd"

IMAGE_INSTALL:append = " systemd-conf"
RUSTVERSION = "1.87%"
```

## meta-bah/conf/layer.conf
```bitbake
# We have a conf and classes directory, add to BBPATH
BBPATH .= ":${LAYERDIR}"

# We have recipes-* directories, add to BBFILES
BBFILES += "${LAYERDIR}/recipes-*/*/*.bb \
            ${LAYERDIR}/recipes-*/*/*.bbappend"

BBFILE_COLLECTIONS += "meta-bah"
BBFILE_PATTERN_meta-bah = "^${LAYERDIR}/"
BBFILE_PRIORITY_meta-bah = "6"
LAYERDEPENDS_meta-bah = "core"
LAYERSERIES_COMPAT_meta-bah = "scarthgap"
```

## meta-bah/wic/device.wks
```
part /boot --source bootimg-partition --ondisk mmcblk0 --fstype=vfat --label boot --active --align 4096 --size 130M
part / --source rootfs --ondisk mmcblk0 --fstype=ext4 --label rootfs --align 4096 --size 800M
part /data --fstype=ext4 --ondisk mmcblk0 --label data --align 4096 --size 29000M
```
